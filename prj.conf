## CMakeLists.txt
```
#
# Copyright (c) 2019 Nordic Semiconductor
#
# SPDX-License-Identifier: LicenseRef-Nordic-5-Clause
#

cmake_minimum_required(VERSION 3.20.0)

find_package(Zephyr REQUIRED HINTS $ENV{ZEPHYR_BASE})
project(GNSS_NRF91)

zephyr_library_sources(src/main.c)

# Add the component LTE
target_sources(app PRIVATE
    components/nrf91_modem/nrf91_modem.c)

target_include_directories(app
    PRIVATE
    ${CMAKE_CURRENT_SOURCE_DIR}/components/nrf91_modem)

# Add the component LTE
target_sources(app PRIVATE
    components/gnss/gnss.c)

target_include_directories(app
    PRIVATE
    ${CMAKE_CURRENT_SOURCE_DIR}/components/gnss)
```

## Kconfig
```
menu "GNSS sample"

choice
	default GNSS_SAMPLE_MODE_CONTINUOUS
	prompt "Select GNSS operation mode"

config GNSS_SAMPLE_MODE_CONTINUOUS
	bool "Continuous tracking"

config GNSS_SAMPLE_MODE_PERIODIC
	bool "Periodic fixes"

endchoice

if GNSS_SAMPLE_MODE_PERIODIC

config GNSS_SAMPLE_PERIODIC_INTERVAL
	int "Fix interval for periodic fixes"
	range 10 65535
	default 120
	help
	  Fix interval (in seconds) for periodic fixes.

config GNSS_SAMPLE_PERIODIC_TIMEOUT
	int "Fix timeout for periodic fixes"
	range 0 65535
	default 120
	help
	  Fix timeout (in seconds) for periodic fixes.
	  If set to zero, GNSS is allowed to run indefinitely until a valid PVT estimate is produced.

endif # GNSS_SAMPLE_MODE_PERIODIC
endmenu

if GNSS_SAMPLE_MODE_CONTINUOUS

choice
	default GNSS_SAMPLE_POWER_SAVING_DISABLED
	prompt "Select GNSS power saving mode (duty-cycling)"

config GNSS_SAMPLE_POWER_SAVING_DISABLED
	bool "No power saving"

config GNSS_SAMPLE_POWER_SAVING_MODERATE
	bool "Power saving without significant performance degradation"

config GNSS_SAMPLE_POWER_SAVING_HIGH
	bool "Power saving with acceptable performance degradation"

endchoice

endif # GNSS_SAMPLE_MODE_CONTINUOUS

config GNSS_SAMPLE_REFERENCE_LATITUDE
	string "Reference position latitude in decimal degrees"
	help
	  When set, the sample calculates the distance from the reference position for each fix.
	  Given in decimal degrees (DD), for example "61.500000".

config GNSS_SAMPLE_REFERENCE_LONGITUDE
	string "Reference position longitude in decimal degrees"
	help
	  When set, the sample calculates the distance from the reference position for each fix.
	  Given in decimal degrees (DD), for example "23.800000".

config GNSS_SAMPLE_LOW_ACCURACY
	bool "Allow low accuracy fixes"
	help
	  Allows fixes with lower accuracy.

menu "Zephyr Kernel"
source "Kconfig.zephyr"
endmenu

module = GNSS_SAMPLE
module-str = GNSS sample
source "${ZEPHYR_BASE}/subsys/logging/Kconfig.template.log_config"
```

## sample.yaml
```
sample:
  name: GNSS sample
tests:
  sample.cellular.gnss:
    sysbuild: true
    build_only: true
    integration_platforms:
      - nrf9160dk/nrf9160/ns
      - nrf9151dk/nrf9151/ns
      - nrf9161dk/nrf9161/ns
    platform_allow:
      - nrf9160dk/nrf9160/ns
      - nrf9151dk/nrf9151/ns
      - nrf9161dk/nrf9161/ns
    tags: ci_build sysbuild ci_samples_cellular

  # Following configurations will be used by the positioning CI integration job to verify PRs
  sample.cellular.gnss.integration_config_positioning_agnss_nrfcloud_ltem_pvt:
    sysbuild: true
    build_only: true
    extra_configs:
      - CONFIG_LTE_NETWORK_MODE_LTE_M_GPS=y
      - CONFIG_LTE_NETWORK_MODE_NBIOT_GPS=n
      - CONFIG_GNSS_SAMPLE_LTE_ON_DEMAND=y
      - CONFIG_GNSS_SAMPLE_ASSISTANCE_NRF_CLOUD=y
      - CONFIG_GNSS_SAMPLE_NMEA_ONLY=n
      - CONFIG_GNSS_SAMPLE_MODE_PERIODIC=n
      - CONFIG_GNSS_SAMPLE_ASSISTANCE_MINIMAL=n
      - CONFIG_LTE_LC_EDRX_MODULE=y
      - CONFIG_LTE_EDRX_REQ=y
      - CONFIG_FPU=y
      - CONFIG_GNSS_SAMPLE_REFERENCE_LATITUDE="61.49375330"
      - CONFIG_GNSS_SAMPLE_REFERENCE_LONGITUDE="23.77588976"
      - CONFIG_MODEM_ANTENNA_GNSS_EXTERNAL=y
      - CONFIG_LOG_BUFFER_SIZE=2048
    extra_args: gnss_SNIPPET="nrf91-modem-trace-uart"
    integration_platforms:
      - nrf9151dk/nrf9151/ns
    platform_allow:
      - nrf9151dk/nrf9151/ns
    tags: ci_build sysbuild ci_samples_cellular
  sample.cellular.gnss.integration_config_positioning_agnss_nrfcloud_nbiot_nmea_lte_on:
    sysbuild: true
    build_only: true
    extra_configs:
      - CONFIG_LTE_NETWORK_MODE_LTE_M_GPS=n
      - CONFIG_LTE_NETWORK_MODE_NBIOT_GPS=y
      - CONFIG_GNSS_SAMPLE_LTE_ON_DEMAND=n
      - CONFIG_GNSS_SAMPLE_ASSISTANCE_NRF_CLOUD=y
      - CONFIG_GNSS_SAMPLE_NMEA_ONLY=y
      - CONFIG_GNSS_SAMPLE_MODE_PERIODIC=n
      - CONFIG_GNSS_SAMPLE_ASSISTANCE_MINIMAL=n
      - CONFIG_LTE_LC_EDRX_MODULE=y
      - CONFIG_LTE_EDRX_REQ=y
      - CONFIG_FPU=y
      - CONFIG_GNSS_SAMPLE_REFERENCE_LATITUDE="61.49375330"
      - CONFIG_GNSS_SAMPLE_REFERENCE_LONGITUDE="23.77588976"
      - CONFIG_MODEM_ANTENNA_GNSS_EXTERNAL=y
      - CONFIG_LOG_BUFFER_SIZE=2048
    extra_args: gnss_SNIPPET="nrf91-modem-trace-uart"
    integration_platforms:
      - nrf9151dk/nrf9151/ns
    platform_allow:
      - nrf9151dk/nrf9151/ns
    tags: ci_build sysbuild ci_samples_cellular
  sample.cellular.gnss.integration_config_positioning_pgps_nrfcloud_ltem_nmea:
    sysbuild: true
    build_only: true
    extra_configs:
      - CONFIG_LTE_NETWORK_MODE_LTE_M_GPS=y
      - CONFIG_LTE_NETWORK_MODE_NBIOT_GPS=n
      - CONFIG_GNSS_SAMPLE_LTE_ON_DEMAND=n
      - CONFIG_GNSS_SAMPLE_ASSISTANCE_NRF_CLOUD=n
      - CONFIG_GNSS_SAMPLE_NMEA_ONLY=y
      - CONFIG_GNSS_SAMPLE_MODE_PERIODIC=n
      - CONFIG_GNSS_SAMPLE_ASSISTANCE_MINIMAL=n
      - CONFIG_LTE_EDRX_REQ=n
      - CONFIG_FPU=y
      - CONFIG_GNSS_SAMPLE_REFERENCE_LATITUDE="61.49375330"
      - CONFIG_GNSS_SAMPLE_REFERENCE_LONGITUDE="23.77588976"
      - CONFIG_MODEM_ANTENNA_GNSS_EXTERNAL=y
      - CONFIG_LOG_BUFFER_SIZE=2048
    extra_args:
      - OVERLAY_CONFIG=overlay-pgps.conf
      - gnss_SNIPPET="nrf91-modem-trace-uart"
    integration_platforms:
      - nrf9151dk/nrf9151/ns
    platform_allow:
      - nrf9151dk/nrf9151/ns
    tags: ci_build sysbuild ci_samples_cellular
  sample.cellular.gnss.integration_config_positioning_gnss_ltem_pvt:
    sysbuild: true
    build_only: true
    extra_configs:
      - CONFIG_LTE_NETWORK_MODE_LTE_M_GPS=y
      - CONFIG_LTE_NETWORK_MODE_NBIOT_GPS=n
      - CONFIG_GNSS_SAMPLE_LTE_ON_DEMAND=n
      - CONFIG_GNSS_SAMPLE_ASSISTANCE_NRF_CLOUD=n
      - CONFIG_GNSS_SAMPLE_NMEA_ONLY=n
      - CONFIG_GNSS_SAMPLE_MODE_PERIODIC=n
      - CONFIG_GNSS_SAMPLE_ASSISTANCE_MINIMAL=n
      - CONFIG_LTE_LC_EDRX_MODULE=y
      - CONFIG_LTE_EDRX_REQ=y
      - CONFIG_FPU=y
      - CONFIG_GNSS_SAMPLE_REFERENCE_LATITUDE="61.49375330"
      - CONFIG_GNSS_SAMPLE_REFERENCE_LONGITUDE="23.77588976"
      - CONFIG_MODEM_ANTENNA_GNSS_EXTERNAL=y
      - CONFIG_LOG_BUFFER_SIZE=2048
    extra_args: gnss_SNIPPET="nrf91-modem-trace-uart"
    integration_platforms:
      - nrf9151dk/nrf9151/ns
    platform_allow:
      - nrf9151dk/nrf9151/ns
    tags: ci_build sysbuild ci_samples_cellular
```

## prj.conf
```kconfig
# General
CONFIG_FPU=y
CONFIG_NRF_MODEM_LIB=y
CONFIG_MODEM_INFO=y
CONFIG_DATE_TIME=y
CONFIG_STDOUT_CONSOLE=y
CONFIG_UART_INTERRUPT_DRIVEN=y
CONFIG_PICOLIBC_IO_FLOAT=y
CONFIG_LOG=y
CONFIG_LOG_MODE_IMMEDIATE=y

# GNSS sample

# LTE Link Control
CONFIG_LTE_LINK_CONTROL=y
CONFIG_LTE_NETWORK_MODE_NBIOT_GPS=y
CONFIG_AT_HOST_LIBRARY=y

# Networking
CONFIG_NETWORKING=y
CONFIG_NET_SOCKETS_OFFLOAD=y
CONFIG_NET_SOCKETS=y
CONFIG_POSIX_API=y
# Disable native network stack to save some memory
CONFIG_NET_NATIVE=n

# Memory and stack configuration
CONFIG_HEAP_MEM_POOL_SIZE=2048
CONFIG_MAIN_STACK_SIZE=4096
CONFIG_SYSTEM_WORKQUEUE_STACK_SIZE=1536
```

## src/main.c
```c
#include <stdio.h>
#include <stdlib.h>
#include <zephyr/kernel.h>
#include <zephyr/logging/log.h>
#include "nrf91_modem.h"
#include "gnss.h"

LOG_MODULE_REGISTER(MAIN);

extern bool ref_used;
extern double ref_latitude;
extern double ref_longitude;

int main(void)
{

	LOG_INF("Starting GNS Based Location Tracking\n\r");

	/* Initialize reference coordinates (if used). */
	if (sizeof(CONFIG_GNSS_SAMPLE_REFERENCE_LATITUDE) > 1 &&
		sizeof(CONFIG_GNSS_SAMPLE_REFERENCE_LONGITUDE) > 1)
	{
		ref_used = true;
		ref_latitude = atof(CONFIG_GNSS_SAMPLE_REFERENCE_LATITUDE);
		ref_longitude = atof(CONFIG_GNSS_SAMPLE_REFERENCE_LONGITUDE);
	}

	if (modem_init() != 0)
	{
		LOG_ERR("Failed to initialize modem");
		return -1;
	}

	if (gnss_init_and_start() != 0)
	{
		LOG_ERR("Failed to initialize and start GNSS");
		return -1;
	}

	while (1)
	{
		gnss_start_searching();
	}

	return 0;
}
```
